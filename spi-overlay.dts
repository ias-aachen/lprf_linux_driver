/dts-v1/;
/plugin/;

/* Overlay SPI interface */

/ {
	compatible = "brcm,bcm2835", "brcm,bcm2836", "brcm,bcm2837", "brcm,bcm2708", "brcm,bcm2709";

	fragment@0 {
		target = <&spi0>;
		__overlay__ {

			status = "okay";
		};
	};
};
