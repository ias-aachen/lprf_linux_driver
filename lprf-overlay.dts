/dts-v1/;
/plugin/;

/* Overlay for LPRF transceiver on spi0.0 */

/ {
	compatible = "brcm,bcm2835", "brcm,bcm2836", "brcm,bcm2708", "brcm,bcm2709";

	fragment@0 {
		target = <&spi0>;
		__overlay__ {
			#address-cells = <1>;
			#size-cells = <0>;

			status = "okay";

			lowpan0: lprf@0 {
				compatible = "ias,lprf";
				reg = <0>;
				spi-max-frequency = <8000000>;
				some-custom-value = <42>;
			};
		};
	};
	

	
};
